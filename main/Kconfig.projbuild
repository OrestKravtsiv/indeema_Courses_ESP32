## main/Kconfig.projbuild
```kconfig
menu "My Project Configuration"

menu "MQTT Configuration"
    config MQTT_BROKER_URI
        string "MQTT Broker URI"
        default "mqtt://broker.hivemq.com:1883"
        help
            URI of the MQTT broker to connect to.
            Examples: mqtt://broker.hivemq.com:1883
                     mqtts://broker.example.com:8883

    config MQTT_TOPIC_PREFIX
        string "MQTT Topic Prefix"
        default "esp-lection"
        help
            Prefix for all MQTT topics (e.g., "esp-lection" becomes "esp-lection/cmd")

    config MQTT_TELEMETRY_INTERVAL
        int "Telemetry publish interval (seconds)"
        default 10
        range 1 300
        help
            How often to publish telemetry data to MQTT broker (1-300 seconds)

    config MQTT_RECONNECT_TIMEOUT_MS
        int "MQTT reconnect timeout (milliseconds)"
        default 2000
        range 100 10000
        help
            Delay before attempting to reconnect to MQTT broker after disconnect

    config MQTT_COMMAND_QUEUE_SIZE
        int "MQTT command queue size"
        default 10
        range 5 50
        help
            Maximum number of MQTT commands that can be queued for processing
endmenu

menu "WiFi Configuration"
    config WIFI_DEFAULT_MODE
        int "Default WiFi Mode (1=STA, 2=AP, 3=APSTA)"
        default 2
        range 1 3
        help
            Initial WiFi mode on startup:
            1 = Station (connect to router)
            2 = Access Point (create hotspot)
            3 = AP+STA (both modes)

    config WIFI_AP_SSID
        string "WiFi AP SSID"
        default "Orest_test"
        help
            SSID for the WiFi Access Point mode

    config WIFI_AP_PASSWORD
        string "WiFi AP Password"
        default "qwerty1234"
        help
            Password for WiFi AP (minimum 8 characters)

    config WIFI_MAX_RETRY
        int "Maximum WiFi reconnect attempts"
        default 5
        range 1 20
        help
            Maximum number of retry attempts when connecting to WiFi in STA mode
endmenu

config MY_PROJECT_FEATURE
    bool "Enable My Project Feature"
    default y
    help
      This option enables the My Project Feature, which provides additional functionality for the project.
endmenu

menu "BLE Configuration"
    config BLE_DEVICE_NAME
        string "BLE Device Name"
        default "ESP32-NimBLE"
        help
            Device name advertised over BLE GAP.

    config BLE_DIS_MANUFACTURER
        string "BLE Manufacturer Name"
        default "Indeema"
        help
            Device Information Service (DIS) manufacturer name.

    config BLE_DIS_MODEL_NUMBER
        string "BLE Model Number"
        default "ESP32S3"
        help
            Device Information Service (DIS) model number.

    config BLE_DIS_SERIAL_NUMBER
        string "BLE Serial Number"
        default "00000001"
        help
            Device Information Service (DIS) serial number.

    config BLE_BATTERY_LEVEL
        int "Initial Battery Level (%)"
        default 100
        range 0 100
        help
            Initial Battery Service (BAS) level reported over BLE.
endmenu
```
